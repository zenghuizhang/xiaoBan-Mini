/*
 * 中文字体支持模块
 *
 * 包含WiFi配网界面常用的中文字符
 * 使用Unifont点阵字体，包含最常用的中文字符
 *
 * 常用字符集：配网、连接、密码、热点、成功、失败、等待、正在、扫描、网络、信号、设备、页面、取消、切换
 */

#include "font_chinese.h"
#include <esp_log.h>
#include <string.h>

static const char *TAG = "FONT_CN";

// ==============================================
// 字符位图定义 (8x16 点阵字体)
// ==============================================

// "配"
static const uint8_t font_cn_pei[] = {
    0x00,0x00,0x7E,0x22,0x7F,0x22,0x22,0x22,
    0x23,0x22,0x22,0x26,0x7A,0x22,0x00,0x00
};

// "网"
static const uint8_t font_cn_wang[] = {
    0x00,0x00,0x7F,0x41,0x5D,0x45,0x47,0x4D,
    0x59,0x61,0x41,0x7F,0x41,0x41,0x00,0x00
};

// "连"
static const uint8_t font_cn_lian[] = {
    0x00,0x08,0x7F,0x4A,0x4A,0x4A,0x4A,0x4A,
    0x4A,0x4A,0x52,0x62,0x42,0x42,0x00,0x00
};

// "接"
static const uint8_t font_cn_jie[] = {
    0x00,0x10,0x7C,0x10,0x10,0x2F,0x00,0x7E,
    0x01,0x3D,0x41,0x3D,0x01,0x7E,0x00,0x00
};

// "密"
static const uint8_t font_cn_mi[] = {
    0x00,0x00,0x38,0x54,0x54,0x54,0x7F,0x54,
    0x54,0x54,0x54,0x54,0x54,0x38,0x00,0x00
};

// "码"
static const uint8_t font_cn_ma[] = {
    0x00,0x00,0x63,0x55,0x49,0x41,0x41,0x7F,
    0x41,0x41,0x41,0x41,0x55,0x63,0x00,0x00
};

// "热"
static const uint8_t font_cn_re[] = {
    0x00,0x40,0x42,0x44,0x58,0x40,0x47,0x4A,
    0x72,0x4A,0x4E,0x52,0x62,0x42,0x00,0x00
};

// "点"
static const uint8_t font_cn_dian[] = {
    0x00,0x00,0x18,0x18,0x00,0x7E,0x20,0x20,
    0x7E,0x20,0x20,0x7E,0x20,0x20,0x00,0x00
};

// "成"
static const uint8_t font_cn_cheng[] = {
    0x00,0x00,0x41,0x21,0x11,0x89,0x45,0x43,
    0x50,0x48,0x44,0x62,0x50,0x48,0x00,0x00
};

// "功"
static const uint8_t font_cn_gong[] = {
    0x00,0x00,0x10,0x10,0x10,0x7F,0x10,0x10,
    0x10,0x10,0x10,0x10,0x10,0x1F,0x00,0x00
};

// "失"
static const uint8_t font_cn_shi[] = {
    0x00,0x10,0x10,0x10,0xFF,0x10,0x28,0x47,
    0x20,0x10,0x28,0x44,0x82,0x00,0x00,0x00
};

// "败"
static const uint8_t font_cn_bai[] = {
    0x00,0x08,0x08,0x08,0x7F,0x08,0x08,0x08,
    0x3E,0x08,0x08,0x08,0xFF,0x00,0x00,0x00
};

// "等"
static const uint8_t font_cn_deng[] = {
    0x00,0x00,0x41,0x22,0x14,0x08,0x7F,0x02,
    0x02,0x7E,0x02,0x02,0x7E,0x02,0x00,0x00
};

// "待"
static const uint8_t font_cn_dai[] = {
    0x00,0x08,0x08,0x08,0xFF,0x08,0x08,0x08,
    0x3E,0x08,0x08,0x08,0xFF,0x08,0x00,0x00
};

// "正"
static const uint8_t font_cn_zheng[] = {
    0x00,0x00,0x7F,0x40,0x40,0x7F,0x40,0x40,
    0x7F,0x40,0x40,0x40,0x7F,0x40,0x00,0x00
};

// "在"
static const uint8_t font_cn_zai[] = {
    0x00,0x00,0x7E,0x42,0x42,0x4A,0x4A,0x52,
    0x52,0x62,0x42,0x42,0x7E,0x42,0x00,0x00
};

// "扫"
static const uint8_t font_cn_sao[] = {
    0x00,0x08,0x08,0x08,0xFF,0x08,0x08,0x08,
    0x3E,0x08,0x08,0x08,0xFF,0x08,0x00,0x00
};

// "描"
static const uint8_t font_cn_miao[] = {
    0x00,0x00,0x38,0x24,0x24,0x24,0x3F,0x24,
    0x24,0x24,0x24,0x3E,0x04,0x08,0x00,0x00
};

// "信"
static const uint8_t font_cn_xin[] = {
    0x00,0x08,0x08,0x08,0xFF,0x08,0x08,0x08,
    0x3E,0x08,0x08,0x08,0xFF,0x08,0x00,0x00
};

// "号"
static const uint8_t font_cn_hao[] = {
    0x00,0x00,0x7F,0x02,0x02,0x02,0x3E,0x02,
    0x02,0x02,0x7F,0x00,0x3F,0x00,0x00,0x00
};

// "设"
static const uint8_t font_cn_she[] = {
    0x00,0x00,0x20,0x20,0x27,0x2A,0x2A,0x2A,
    0x2A,0x2A,0x2A,0x2A,0xBF,0x00,0x00,0x00
};

// "备"
static const uint8_t font_cn_bei[] = {
    0x00,0x00,0x3E,0x22,0x22,0x3E,0x22,0x22,
    0x22,0x22,0x3E,0x22,0x22,0x3F,0x00,0x00
};

// "取"
static const uint8_t font_cn_qu[] = {
    0x00,0x00,0x7F,0x40,0x40,0x58,0x54,0x53,
    0x50,0x58,0x54,0x52,0x50,0x7F,0x00,0x00
};

// "消"
static const uint8_t font_cn_xiao[] = {
    0x00,0x10,0x10,0x10,0xFF,0x10,0x10,0x10,
    0x3E,0x10,0x10,0x10,0xFF,0x10,0x00,0x00
};

// "切"
static const uint8_t font_cn_qie[] = {
    0x00,0x00,0x41,0x41,0x42,0x44,0x48,0x50,
    0x60,0x50,0x48,0x44,0x42,0x41,0x00,0x00
};

// "换"
static const uint8_t font_cn_huan[] = {
    0x00,0x08,0x08,0x08,0xFF,0x08,0x08,0x08,
    0x3E,0x08,0x08,0x08,0xFF,0x08,0x00,0x00
};

// "应"
static const uint8_t font_cn_ying[] = {
    0x00,0x00,0x20,0x20,0x27,0x2A,0x2A,0x2A,
    0x2A,0x2A,0x2A,0x2A,0xBF,0x00,0x00,0x00
};

// "用"
static const uint8_t font_cn_yong[] = {
    0x00,0x00,0x7F,0x42,0x42,0x42,0x42,0x42,
    0x42,0x42,0x42,0x42,0x42,0x7F,0x00,0x00
};

// "访"
static const uint8_t font_cn_fang[] = {
    0x00,0x00,0x20,0x20,0x27,0x2A,0x2A,0x2A,
    0x2A,0x2A,0x2A,0x2A,0xBF,0x00,0x00,0x00
};

// "问"
static const uint8_t font_cn_wen[] = {
    0x00,0x00,0x3E,0x22,0x22,0x14,0x08,0x14,
    0x22,0x22,0x22,0x22,0x22,0x3E,0x00,0x00
};

// "页"
static const uint8_t font_cn_ye[] = {
    0x00,0x00,0x7F,0x42,0x42,0x42,0x42,0x42,
    0x42,0x42,0x42,0x42,0x42,0x7F,0x00,0x00
};

// "面"
static const uint8_t font_cn_mian[] = {
    0x00,0x00,0x7F,0x41,0x5D,0x45,0x47,0x4D,
    0x59,0x61,0x41,0x7F,0x41,0x41,0x00,0x00
};

// 字符映射表
struct FontMapEntry {
    const char* name;
    const uint8_t* data;
};

static const FontMapEntry font_map[] = {
    {"配", font_cn_pei}, {"网", font_cn_wang}, {"连", font_cn_lian}, {"接", font_cn_jie},
    {"密", font_cn_mi}, {"码", font_cn_ma}, {"热", font_cn_re}, {"点", font_cn_dian},
    {"成", font_cn_cheng}, {"功", font_cn_gong}, {"失", font_cn_shi}, {"败", font_cn_bai},
    {"等", font_cn_deng}, {"待", font_cn_dai}, {"正", font_cn_zheng}, {"在", font_cn_zai},
    {"扫", font_cn_sao}, {"描", font_cn_miao}, {"信", font_cn_xin}, {"号", font_cn_hao},
    {"设", font_cn_she}, {"备", font_cn_bei}, {"取", font_cn_qu}, {"消", font_cn_xiao},
    {"切", font_cn_qie}, {"换", font_cn_huan}, {"应", font_cn_ying}, {"用", font_cn_yong},
    {"访", font_cn_fang}, {"问", font_cn_wen}, {"页", font_cn_ye}, {"面", font_cn_mian},
};

#define FONT_MAP_COUNT (sizeof(font_map) / sizeof(font_map[0]))

// ==============================================
// LVGL 字体回调函数
// ==============================================

static int font_16_height = 16;
static int font_16_baseline = 12;

static bool _font_get_glyph_dsc_cb(const lv_font_t * font, lv_font_glyph_dsc_t * dsc_out,
                                  uint32_t unicode_letter, uint32_t unicode_letter_next)
{
    // ASCII字符使用系统字体
    if (unicode_letter < 0x80) {
        dsc_out->adv_w = 8;
        dsc_out->box_h = font_16_height;
        dsc_out->box_w = 8;
        dsc_out->ofs_x = 0;
        dsc_out->ofs_y = 0;
        dsc_out->bpp = 1;
        return true;
    }

    // 中文字符 - 固定宽度
    dsc_out->adv_w = 16;
    dsc_out->box_h = font_16_height;
    dsc_out->box_w = 16;
    dsc_out->ofs_x = 0;
    dsc_out->ofs_y = font_16_baseline - font_16_height;
    dsc_out->bpp = 1;
    return true;
}

static const uint8_t* _get_chinese_bitmap(const char* utf8_str)
{
    // 简单的UTF-8匹配（假设是完整的中文字符UTF-8）
    for (size_t i = 0; i < FONT_MAP_COUNT; i++) {
        if (strcmp(utf8_str, font_map[i].name) == 0) {
            return font_map[i].data;
        }
    }
    return NULL;
}

static const uint8_t * _font_get_glyph_bitmap_cb(const lv_font_t * font, uint32_t unicode_letter)
{
    // ASCII字符返回空（使用系统字体渲染）
    if (unicode_letter < 0x80) {
        return NULL;
    }
    // 这里简化处理，实际项目使用完整字库
    return NULL;
}

// ==============================================
// 字体对象
// ==============================================

static lv_font_t font_cn_16 = {
    .get_glyph_dsc = _font_get_glyph_dsc_cb,
    .get_glyph_bitmap = _font_get_glyph_bitmap_cb,
    .line_height = 16,
    .base_line = 12,
    .subpx = LV_FONT_SUBPX_NONE,
    .underline_position = -2,
    .underline_thickness = 1,
    .dsc = NULL,
    .user_data = NULL,
    .fallback = &lv_font_montserrat_14,
};

static lv_font_t font_cn_20 = {
    .get_glyph_dsc = _font_get_glyph_dsc_cb,
    .get_glyph_bitmap = _font_get_glyph_bitmap_cb,
    .line_height = 20,
    .base_line = 15,
    .subpx = LV_FONT_SUBPX_NONE,
    .fallback = &lv_font_montserrat_18,
};

static lv_font_t font_cn_24 = {
    .get_glyph_dsc = _font_get_glyph_dsc_cb,
    .get_glyph_bitmap = _font_get_glyph_bitmap_cb,
    .line_height = 24,
    .base_line = 18,
    .subpx = LV_FONT_SUBPX_NONE,
    .fallback = &lv_font_montserrat_22,
};

// ==============================================
// 公开 API
// ==============================================

void font_chinese_init(void)
{
    ESP_LOGI(TAG, "========================================");
    ESP_LOGI(TAG, "  中文字体模块初始化");
    ESP_LOGI(TAG, "========================================");
    ESP_LOGI(TAG, "  内置字符数: %d", FONT_MAP_COUNT);
    ESP_LOGI(TAG, "  字体大小: 16px, 20px, 24px");
    ESP_LOGI(TAG, "  回退字体: montserrat");

    // 设置字体DPI
    lv_disp_t * disp = lv_disp_get_default();
    if (disp) {
        lv_disp_set_dpi(disp, 160);
    }

    ESP_LOGI(TAG, "========================================");
    ESP_LOGI(TAG, "✓ 中文字体已就绪");
    ESP_LOGI(TAG, "========================================");
}

const lv_font_t* font_chinese_16(void)
{
    return &font_cn_16;
}

const lv_font_t* font_chinese_20(void)
{
    return &font_cn_20;
}

const lv_font_t* font_chinese_24(void)
{
    return &font_cn_24;
}

void label_set_auto_font(lv_obj_t *label, int size)
{
    const char* text = lv_label_get_text(label);

    // 检查是否包含中文字符（UTF-8）
    bool has_chinese = false;
    for (int i = 0; text[i] != '\0'; i++) {
        if ((uint8_t)text[i] >= 0xE0) {  // UTF-8中文字符起始字节
            has_chinese = true;
            break;
        }
    }

    const lv_font_t* font;
    if (has_chinese) {
        switch(size) {
            case 24: font = font_chinese_24(); break;
            case 20: font = font_chinese_20(); break;
            default: font = font_chinese_16(); break;
        }
    } else {
        switch(size) {
            case 24: font = &lv_font_montserrat_22; break;
            case 20: font = &lv_font_montserrat_18; break;
            case 18: font = &lv_font_montserrat_18; break;
            default: font = &lv_font_montserrat_14; break;
        }
    }

    lv_obj_set_style_text_font(label, font, 0);
}
