## cores3-espidf/sdkconfig.defaults
```kconfig
CONFIG_IDF_TARGET="esp32s3"
CONFIG_ESP32S3_DEFAULT_CPU_FREQ_240=y
CONFIG_ESP32S3_SPIRAM_SUPPORT=y
CONFIG_ESP32S3_SPIRAM_MODE_OCT=y
CONFIG_SPIRAM=y
CONFIG_SPIRAM_SPEED_80M=y
CONFIG_ESPTOOLPY_FLASHSIZE_16MB=y
CONFIG_ESPTOOLPY_FLASHMODE_QIO=y
CONFIG_ESPTOOLPY_FLASHFREQ_80M=y

CONFIG_LV_COLOR_DEPTH_16=y
CONFIG_LV_COLOR_DEPTH=16
CONFIG_LV_USE_ANTIALIAS=y
CONFIG_LV_USE_GRADIENT=y
CONFIG_LV_USE_OPA_SCALE=y
CONFIG_FREERTOS_HZ=1000

# 修复 Tmr Svc 堆栈溢出：默认 2048 -> 8192
CONFIG_FREERTOS_TIMER_TASK_STACK_DEPTH=8192
CONFIG_LV_USE_SNAPSHOT=y
CONFIG_ESP_CONSOLE_USB_SERIAL_JTAG=y
CONFIG_ESP_MAIN_TASK_STACK_SIZE=16384
```
